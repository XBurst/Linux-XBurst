## Documentation/devicetree/bindings/mips/ingenic/ingenic,cpu.txt
```
Bindings for Ingenic XBurst family CPUs.

Required properties:
- device_type: Must be "cpu".
- compatible: One of:
  - "ingenic,xburst".
  - "ingenic,xburst2".
- reg: The number of the CPU.

Example:
cpus {
	#address-cells = <1>;
	#size-cells = <0>;

	cpu0: cpu@0 {
		device_type = "cpu";
		compatible = "ingenic,xburst";
		reg = <0>;

		clocks = <&cgu JZ4780_CLK_CPU>;
		clock-names = "cpu";
	};

	cpu1: cpu@1 {
		device_type = "cpu";
		compatible = "ingenic,xburst";
		reg = <1>;

		clocks = <&cgu JZ4780_CLK_CORE1>;
		clock-names = "cpu";
	};
};
```

## Documentation/devicetree/bindings/mips/ingenic/ingenic,cpu.yaml
```yaml
# SPDX-License-Identifier: (GPL-2.0-only OR BSD-2-Clause)
%YAML 1.2
---
$id: http://devicetree.org/schemas/mips/ingenic/ingenic,cpu.yaml#
$schema: http://devicetree.org/meta-schemas/core.yaml#

title: Bindings for Ingenic XBurst family CPUs

maintainers:
  - 周琰杰 (Zhou Yanjie) <zhouyanjie@wanyeetech.com>
description: |
  Ingenic XBurst family CPUs shall have the following properties.

properties:
  compatible:
    oneOf:
      - const: ingenic,xburst
      - const: ingenic,xburst2

  reg:
    description: |
      The number of the CPU.

required:
  - device_type
  - compatible
  - reg

examples:
  - |
    cpus {
    	#address-cells = <1>;
    	#size-cells = <0>;

    	cpu0: cpu@0 {
    		device_type = "cpu";
    		compatible = "ingenic,xburst";
    		reg = <0>;

    		clocks = <&cgu JZ4780_CLK_CPU>;
    		clock-names = "cpu";
    	};

    	cpu1: cpu@1 {
    		device_type = "cpu";
    		compatible = "ingenic,xburst";
    		reg = <1>;

    		clocks = <&cgu JZ4780_CLK_CORE1>;
    		clock-names = "cpu";
    	};
    };
...
```

## Documentation/devicetree/bindings/mips/ingenic/ingenic,soc.yaml
```yaml
# SPDX-License-Identifier: (GPL-2.0-only OR BSD-2-Clause)
%YAML 1.2
---
$id: http://devicetree.org/schemas/mips/ingenic/ingenic,soc.yaml#
$schema: http://devicetree.org/meta-schemas/core.yaml#

title: Bindings for Ingenic SoCs with XBurst CPU inside.

maintainers:
  - 周琰杰 (Zhou Yanjie) <zhouyanjie@wanyeetech.com>
description: |
  Ingenic SoCs with XBurst CPU inside shall have the following properties.

properties:
  compatible:
    oneOf:
      - const: ingenic,jz4740
      - const: ingenic,jz4725b
      - const: ingenic,jz4760
      - const: ingenic,jz4760b
      - const: ingenic,jz4770
      - const: ingenic,jz4780
      - const: ingenic,x1000
      - const: ingenic,x1000e
      - const: ingenic,x1500

required:
  - compatible

examples:
  - |
    #address-cells = <1>;
    #size-cells = <1>;
    compatible = "ingenic,jz4780";
...
```
